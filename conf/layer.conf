## conf/layer.conf
```bitbake
# We have a conf and classes directory, add to BBPATH
BBPATH .= ":${LAYERDIR}"

# We have recipes-* directories, add to BBFILES
BBFILES += "${LAYERDIR}/recipes-*/*/*.bb \
	${LAYERDIR}/recipes-*/*/*.bbappend"

LAYERSERIES_COMPAT_dbox = "rocko thud warrior"

BBFILE_COLLECTIONS += "dbox"
BBFILE_PATTERN_dbox = "^${LAYERDIR}/"
BBFILE_PRIORITY_dbox = "99"
```
